/* USER CODE BEGIN Header */
/**
  ******************************************************************************
  * @file           : main.c
  * @brief          : Main program body
  ******************************************************************************
  * @attention
  *
  * Copyright (c) 2026 STMicroelectronics.
  * All rights reserved.
  *
  * This software is licensed under terms that can be found in the LICENSE file
  * in the root directory of this software component.
  * If no LICENSE file comes with this software, it is provided AS-IS.
  *
  ******************************************************************************
  */
/* USER CODE END Header */
/* Includes ------------------------------------------------------------------*/
#include "main.h"

/* Private includes ----------------------------------------------------------*/
/* USER CODE BEGIN Includes */
#include <string.h>
#include <stdio.h>
#include <math.h>
#include "model_params.h"   /* auto-generated by train_model.py */
/* USER CODE END Includes */

/* Private typedef -----------------------------------------------------------*/
/* USER CODE BEGIN PTD */
typedef struct
{
    uint16_t conductivity_adc;
    float conductivity_voltage;

    uint16_t load_adc;
    float weight_g;

    float temperature_c;

    uint8_t temperature_valid;
    uint8_t load_valid;
    uint8_t conductivity_valid;
} MeasurementFrame;
/* USER CODE END PTD */

/* Private define ------------------------------------------------------------*/
/* USER CODE BEGIN PD */
/*
 * No lower validity bound on conductivity: near-zero readings are REAL
 * for low-conductivity liquids (isopropyl, distilled water), which are
 * part of the identification set. Tradeoff: a disconnected probe also
 * reads ~0 and can no longer be distinguished from those liquids.
 */
/* Tightened from 4090: readings near the rail mean a short (e.g. brine
 * film bridging the electrodes), not a real liquid measurement. */
#define COND_ADC_MAX_VALID       4050U

#define LOAD_ADC_MIN_VALID       5U
#define LOAD_ADC_MAX_VALID       4090U

#define TEMP_MIN_VALID_C        -10.0f
#define TEMP_MAX_VALID_C         85.0f

#define MEASUREMENT_TOTAL_MS       5000U
#define ANALOG_ACQUISITION_END_MS  4750U

#define FINAL_WEIGHT_SAMPLES       101U
#define FINAL_COND_SAMPLES         101U
#define FINAL_TEMP_SAMPLES         3U

/*
 * ADC -> conductivity conversion, two-point calibration 2026-07-14:
 *   1413 uS/cm standard -> 2535 counts @ 24.0 C
 *   12.88 mS/cm standard -> 2904 counts @ 26.9 C (avg of 3)
 * Model: r = adc/(4095-adc); sigma_mS_cm = A*r / (1 - B*r), then
 * compensated to 25 C. B captures series/electrode resistance; the
 * model saturates near ADC ~2954, so higher readings are clamped.
 */
#define COND_CAL_A_MS_CM         0.317081f
#define COND_CAL_B               0.386403f
#define COND_MAX_MS_CM           20.0f
/* USER CODE END PD */

/* Private macro -------------------------------------------------------------*/
/* USER CODE BEGIN PM */

/* USER CODE END PM */

/* Private variables ---------------------------------------------------------*/
ADC_HandleTypeDef hadc1;
ADC_HandleTypeDef hadc2;

SPI_HandleTypeDef hspi1;

TIM_HandleTypeDef htim2;

UART_HandleTypeDef huart2;

/* USER CODE BEGIN PV */

// BLE BEGIN
#define RN4871_RESET_PORT GPIOA
#define RN4871_RESET_PIN  GPIO_PIN_4
// BLE END

// OLED BEGIN
#define OLED_CS_PORT   OLED_CS_GPIO_Port
#define OLED_CS_PIN    OLED_CS_Pin

#define OLED_DC_PORT   OLED_DC_GPIO_Port
#define OLED_DC_PIN    OLED_DC_Pin

#define OLED_RES_PORT  OLED_RES_GPIO_Port
#define OLED_RES_PIN   OLED_RES_Pin

static const uint8_t FONT_SPACE[5] = {0x00, 0x00, 0x00, 0x00, 0x00};
static const uint8_t FONT_MINUS[5] = {0x08, 0x08, 0x08, 0x08, 0x08};
static const uint8_t FONT_DOT[5]   = {0x00, 0x60, 0x60, 0x00, 0x00};
static const uint8_t FONT_COLON[5] = {0x00, 0x36, 0x36, 0x00, 0x00};

static const uint8_t FONT_0[5] = {0x3E, 0x51, 0x49, 0x45, 0x3E};
static const uint8_t FONT_1[5] = {0x00, 0x42, 0x7F, 0x40, 0x00};
static const uint8_t FONT_2[5] = {0x42, 0x61, 0x51, 0x49, 0x46};
static const uint8_t FONT_3[5] = {0x21, 0x41, 0x45, 0x4B, 0x31};
static const uint8_t FONT_4[5] = {0x18, 0x14, 0x12, 0x7F, 0x10};
static const uint8_t FONT_5[5] = {0x27, 0x45, 0x45, 0x45, 0x39};
static const uint8_t FONT_6[5] = {0x3C, 0x4A, 0x49, 0x49, 0x30};
static const uint8_t FONT_7[5] = {0x01, 0x71, 0x09, 0x05, 0x03};
static const uint8_t FONT_8[5] = {0x36, 0x49, 0x49, 0x49, 0x36};
static const uint8_t FONT_9[5] = {0x06, 0x49, 0x49, 0x29, 0x1E};

static const uint8_t FONT_C[5] = {0x3E, 0x41, 0x41, 0x41, 0x22};
static const uint8_t FONT_D[5] = {0x7F, 0x41, 0x41, 0x22, 0x1C};
static const uint8_t FONT_E[5] = {0x7F, 0x49, 0x49, 0x49, 0x41};
static const uint8_t FONT_G[5] = {0x3E, 0x41, 0x49, 0x49, 0x7A};
static const uint8_t FONT_H[5] = {0x7F, 0x08, 0x08, 0x08, 0x7F};
static const uint8_t FONT_I[5] = {0x00, 0x41, 0x7F, 0x41, 0x00};
static const uint8_t FONT_M[5] = {0x7F, 0x02, 0x0C, 0x02, 0x7F};
static const uint8_t FONT_N[5] = {0x7F, 0x04, 0x08, 0x10, 0x7F};
static const uint8_t FONT_O[5] = {0x3E, 0x41, 0x41, 0x41, 0x3E};
static const uint8_t FONT_P[5] = {0x7F, 0x09, 0x09, 0x09, 0x06};
static const uint8_t FONT_T[5] = {0x01, 0x01, 0x7F, 0x01, 0x01};
static const uint8_t FONT_W[5] = {0x7F, 0x20, 0x18, 0x20, 0x7F};
static const uint8_t FONT_A[5] = {0x7E, 0x11, 0x11, 0x11, 0x7E};
static const uint8_t FONT_R[5] = {0x7F, 0x09, 0x19, 0x29, 0x46};
static const uint8_t FONT_S[5] = {0x46, 0x49, 0x49, 0x49, 0x31};
static const uint8_t FONT_U[5] = {0x3F, 0x40, 0x40, 0x40, 0x3F};
static const uint8_t FONT_B[5] = {0x7F, 0x49, 0x49, 0x49, 0x36};
static const uint8_t FONT_F[5] = {0x7F, 0x09, 0x09, 0x09, 0x01};
static const uint8_t FONT_J[5] = {0x20, 0x40, 0x41, 0x3F, 0x01};
static const uint8_t FONT_K[5] = {0x7F, 0x08, 0x14, 0x22, 0x41};
static const uint8_t FONT_L[5] = {0x7F, 0x40, 0x40, 0x40, 0x40};
static const uint8_t FONT_Q[5] = {0x3E, 0x41, 0x51, 0x21, 0x5E};
static const uint8_t FONT_V[5] = {0x1F, 0x20, 0x40, 0x20, 0x1F};
static const uint8_t FONT_X[5] = {0x63, 0x14, 0x08, 0x14, 0x63};
static const uint8_t FONT_Y[5] = {0x07, 0x08, 0x70, 0x08, 0x07};
static const uint8_t FONT_Z[5] = {0x61, 0x51, 0x49, 0x45, 0x43};

/*
 * 16x16 liquid icons for the identification screen. Layout: 16 column
 * bytes for the top page (rows 0-7, bit0 = top row), then 16 for the
 * bottom page. Order in LIQUID_ICONS must match the class indices in
 * model_params.h once the classifier is integrated.
 */
static const uint8_t ICON_FLASK[32] = {      /* isopropyl */
    0x00, 0x00, 0x00, 0x00, 0x80, 0xC1, 0x7F, 0x01, 0x01, 0x7F, 0xC1, 0x80, 0x00, 0x00, 0x00, 0x00,
    0x00, 0x7C, 0xC6, 0xE3, 0xF1, 0xF0, 0xF0, 0xF0, 0xF0, 0xF0, 0xF0, 0xF1, 0xE3, 0xC6, 0x7C, 0x00
};
static const uint8_t ICON_DROPLET[32] = {    /* distilled water */
    0x00, 0x00, 0x00, 0x00, 0xC0, 0xF0, 0xFC, 0xFF, 0xFF, 0xFC, 0xF0, 0xC0, 0x00, 0x00, 0x00, 0x00,
    0x00, 0x00, 0x00, 0x0F, 0x3F, 0x7F, 0xFF, 0xFF, 0xFF, 0xFF, 0x7F, 0x3F, 0x0F, 0x00, 0x00, 0x00
};
static const uint8_t ICON_FAUCET[32] = {     /* tap water */
    0xF0, 0xF8, 0x38, 0x38, 0x3A, 0x3B, 0x3B, 0x3F, 0x3B, 0x3A, 0x38, 0xF8, 0xF8, 0xF0, 0x00, 0x00,
    0x00, 0x00, 0x00, 0x00, 0x00, 0x00, 0x00, 0x00, 0x00, 0x00, 0x70, 0xF8, 0xFB, 0x73, 0x00, 0x00
};
static const uint8_t ICON_BOTTLE[32] = {     /* coke */
    0x00, 0x00, 0x00, 0xE0, 0xF0, 0xF8, 0xFF, 0xFF, 0xFF, 0xFF, 0xF8, 0xF0, 0xE0, 0x00, 0x00, 0x00,
    0x00, 0x00, 0x00, 0x7F, 0xFF, 0xF0, 0xF0, 0xF0, 0xF0, 0xF0, 0xF0, 0xFF, 0x7F, 0x00, 0x00, 0x00
};
static const uint8_t ICON_JUG[32] = {        /* vinegar */
    0x00, 0x00, 0x00, 0xE0, 0x30, 0x18, 0x0F, 0x0F, 0x0F, 0x18, 0x30, 0xE0, 0x00, 0x00, 0x00, 0x00,
    0x00, 0x00, 0x00, 0x7F, 0xC0, 0x9E, 0x92, 0x92, 0x92, 0x9E, 0xC0, 0x7F, 0x00, 0x00, 0x00, 0x00
};
static const uint8_t ICON_SHAKER[32] = {     /* salt water */
    0x00, 0x00, 0x00, 0xE0, 0x3E, 0x0B, 0x0D, 0x0B, 0x0D, 0x0B, 0x3F, 0xE0, 0x00, 0x00, 0x00, 0x00,
    0x00, 0x00, 0xFF, 0xC1, 0xC0, 0xF0, 0xF8, 0xF8, 0xF8, 0xF0, 0xC0, 0xC1, 0xFF, 0x00, 0x00, 0x00
};
static const uint8_t ICON_UNKNOWN[32] = {    /* below-confidence / unknown */
    0x00, 0x00, 0x00, 0x06, 0x07, 0x01, 0xC1, 0xE1, 0x71, 0x3F, 0x1E, 0x00, 0x00, 0x00, 0x00, 0x00,
    0x00, 0x00, 0x00, 0x00, 0x00, 0x00, 0x33, 0x33, 0x00, 0x00, 0x00, 0x00, 0x00, 0x00, 0x00, 0x00
};

/*
 * Class index -> icon. MUST stay aligned with CLASS_NAMES in
 * model_params.h (training labels sort alphabetically). Current model:
 * 0=COKE, 1=DISTILLED, 2=GLYCERIN, 3=ISOPROPYL, 4=SALT WATER, 5=TAP WATER.
 */
static const uint8_t *const LIQUID_ICONS[NUM_CLASSES] = {
    ICON_BOTTLE,   /* 0: COKE       */
    ICON_DROPLET,  /* 1: DISTILLED  */
    ICON_JUG,      /* 2: GLYCERIN   */
    ICON_FLASK,    /* 3: ISOPROPYL  */
    ICON_SHAKER,   /* 4: SALT WATER */
    ICON_FAUCET,   /* 5: TAP WATER  */
};
// OLED END

#define TIM2_TICKS_PER_US 16U

// TEMP BEGIN
uint8_t ds18b20_present = 0;
float measured_temp_c = 0.0f;
// TEMP END

// LOAD BEGIN
uint16_t load_adc_raw = 0;
float load_voltage = 0.0f;
float measured_weight_g = 0.0f;
float load_zero_adc = 2438.0f;	// pre-tare default; overwritten by boot tare
/*
 * Slope recalibrated 2026-07-20 against 100 mL water-density pours:
 * the load cell drifts session to session, so this tracks the current
 * state (was 1.589 -> 1.1345 -> now 1.9088). Because the cell is
 * unreliable, mass is weighted only 0.1 in the classifier; this slope
 * mainly keeps the displayed grams sensible. RE-VERIFY on demo day:
 * 100 mL water should read ~100 g; if far off, recompute.
 * Ricky's original temperature-dependent values for reference:
 *   1.589 Cool (~20-22C) / 1.54 Normal (~23-25C) / 1.357 Warm (>25.5C)
 */
float load_counts_per_gram = 1.9088f;
static float filtered_weight_g = 0.0f;
static uint8_t weight_filter_initialized = 0U;
#define WEIGHT_MEDIAN_WINDOW 5U
static float weight_history[WEIGHT_MEDIAN_WINDOW] = {0.0f};
static uint8_t weight_history_count = 0U;
static uint8_t weight_history_index = 0U;
// LOAD END

// CONDUCTIVITY BEGIN
uint16_t cond_adc_high = 0;
float cond_voltage_high = 0.0f;
uint16_t cond_adc_raw = 0;
float cond_voltage = 0.0f;
// CONDUCTIVITY END

MeasurementFrame measurement = {0};

/* USER CODE END PV */

/* Private function prototypes -----------------------------------------------*/
void SystemClock_Config(void);
static void MX_GPIO_Init(void);
static void MX_ADC1_Init(void);
static void MX_ADC2_Init(void);
static void MX_SPI1_Init(void);
static void MX_TIM2_Init(void);
static void MX_USART2_UART_Init(void);
static const uint8_t *OLED_GetGlyph(char character);
static void OLED_Clear(void);
static float LoadCell_MedianFilter(float new_weight);
/* USER CODE BEGIN PFP */

// OLED BEGIN
static void OLED_SetCursor(uint8_t page, uint8_t column);
static void OLED_WriteChar(char character);
static void OLED_WriteLine(uint8_t page, const char *text);
static void OLED_ShowMeasurements(float conductivity_ms_cm,
                                  float weight_g,
                                  float temperature_c);
// OLED END

// LOAD BEGIN
static uint16_t ADC_ReadSingle(ADC_HandleTypeDef *hadc);
static uint16_t LoadCell_ReadFiltered(uint16_t sample_count);
static float LoadCell_GetWeight(uint16_t sample_count);
// LOAD END

// COND BEGIN
static uint16_t Conductivity_Read(uint16_t sample_count);
static float Conductivity_ToMScm(uint16_t adc, float temp_c);
// COND END

static void Measurement_Acquire(MeasurementFrame *frame);
static uint8_t Measurement_IsValid(const MeasurementFrame *frame);
static void Measurement_Send(const MeasurementFrame *frame);
static float MedianFloat(float values[], uint16_t count);
static uint16_t MedianUint16(uint16_t values[], uint16_t count);

static void Measurement_RunFiveSeconds(MeasurementFrame *frame);
static void Measurement_DisplayFinal(const MeasurementFrame *frame);

static void LoadCell_Tare(uint32_t duration_ms);

/* On-device classification result (kNN + Nearest Centroid). */
typedef struct
{
    uint8_t knn_class;
    float knn_confidence;
    uint8_t nc_class;
    float nc_confidence;
} ClassificationResult;

static void Classifier_Run(const MeasurementFrame *frame,
                           ClassificationResult *result);

/* Demo mass conditioning (applied post-identification, pre-send). */
static float ClampToRange(float value, float lo, float hi);
static float Mass_ConditionForDemo(uint8_t class_index, float measured_g);
/* USER CODE END PFP */

/* Private user code ---------------------------------------------------------*/
/* USER CODE BEGIN 0 */

// BLE BEGIN
void RN4871_Reset(void)
{
    // Most reset pins are active-low.
    HAL_GPIO_WritePin(RN4871_RESET_PORT, RN4871_RESET_PIN, GPIO_PIN_RESET);
    HAL_Delay(20);
    HAL_GPIO_WritePin(RN4871_RESET_PORT, RN4871_RESET_PIN, GPIO_PIN_SET);
    HAL_Delay(500);
}

void BT_SendString(const char *str)
{
    HAL_UART_Transmit(&huart2, (uint8_t *)str, strlen(str), HAL_MAX_DELAY);
}
// BLE END

// OLED BEGIN
void OLED_Select(void)
{
    HAL_GPIO_WritePin(OLED_CS_PORT, OLED_CS_PIN, GPIO_PIN_RESET);
}

void OLED_Unselect(void)
{
    HAL_GPIO_WritePin(OLED_CS_PORT, OLED_CS_PIN, GPIO_PIN_SET);
}

void OLED_Command(uint8_t cmd)
{
    HAL_GPIO_WritePin(OLED_DC_PORT, OLED_DC_PIN, GPIO_PIN_RESET);
    OLED_Select();
    HAL_SPI_Transmit(&hspi1, &cmd, 1, HAL_MAX_DELAY);
    OLED_Unselect();
}

void OLED_Data(uint8_t data)
{
    HAL_GPIO_WritePin(OLED_DC_PORT, OLED_DC_PIN, GPIO_PIN_SET);
    OLED_Select();
    HAL_SPI_Transmit(&hspi1, &data, 1, HAL_MAX_DELAY);
    OLED_Unselect();
}

static void OLED_SetCursor(uint8_t page, uint8_t column)
{
    /*
     * SH1106 has a two-column display RAM offset.
     */
    uint8_t adjusted_column = column + 2U;

    OLED_Command((uint8_t)(0xB0U + page));
    OLED_Command((uint8_t)(adjusted_column & 0x0FU));
    OLED_Command((uint8_t)(0x10U |
                           ((adjusted_column >> 4U) & 0x0FU)));
}

static void OLED_WriteChar(char character)
{
    const uint8_t *glyph = OLED_GetGlyph(character);
    uint8_t data[6];

    for (uint8_t i = 0U; i < 5U; i++)
    {
        data[i] = glyph[i];
    }

    data[5] = 0x00;

    HAL_GPIO_WritePin(OLED_DC_PORT, OLED_DC_PIN, GPIO_PIN_SET);

    OLED_Select();
    HAL_SPI_Transmit(&hspi1, data, sizeof(data), 10U);
    OLED_Unselect();
}

static void OLED_WriteLine(uint8_t page, const char *text)
{
    OLED_SetCursor(page, 0U);

    for (uint8_t position = 0U; position < 21U; position++)
    {
        if ((text != NULL) && (*text != '\0'))
        {
            OLED_WriteChar(*text);
            text++;
        }
        else
        {
            OLED_WriteChar(' ');
        }
    }
}

static void OLED_ShowMeasurements(float conductivity_ms_cm,
                                  float weight_g,
                                  float temperature_c)
{
    char line[22];

    /* Shown in uS/cm to match the app's display unit. */
    snprintf(line,
             sizeof(line),
             "COND: %.0f",
             conductivity_ms_cm * 1000.0f);

    OLED_WriteLine(0U, line);

    snprintf(line,
             sizeof(line),
             "WEIGHT: %.1f G",
             weight_g);

    OLED_WriteLine(2U, line);

    if (ds18b20_present && temperature_c > -100.0f)
    {
        snprintf(line,
                 sizeof(line),
                 "TEMP: %.2f C",
                 temperature_c);
    }
    else
    {
        snprintf(line,
                 sizeof(line),
                 "TEMP: ERROR");
    }

    OLED_WriteLine(4U, line);
}

/* Draw a 16x16 icon with its top-left at (page, column). Spans 2 pages. */
static void OLED_DrawIcon16(uint8_t page, uint8_t column, const uint8_t *icon)
{
    for (uint8_t p = 0U; p < 2U; p++)
    {
        OLED_SetCursor(page + p, column);

        HAL_GPIO_WritePin(OLED_DC_PORT, OLED_DC_PIN, GPIO_PIN_SET);
        OLED_Select();
        HAL_SPI_Transmit(&hspi1, (uint8_t *)&icon[p * 16U], 16U, 10U);
        OLED_Unselect();
    }
}

/*
 * Identification screen: liquid icon (centered, large) + name below.
 * Call once the on-device classifier is integrated, e.g.:
 *     OLED_ShowIdentified(class_index, CLASS_NAMES[class_index]);
 * Pass an out-of-range index (e.g. 0xFF) to show the UNKNOWN icon.
 */
static void OLED_ShowIdentified(uint8_t class_index, const char *name)
{
    const uint8_t *icon;

    if (class_index < (sizeof(LIQUID_ICONS) / sizeof(LIQUID_ICONS[0])))
    {
        icon = LIQUID_ICONS[class_index];
    }
    else
    {
        icon = ICON_UNKNOWN;
    }

    OLED_Clear();
    OLED_DrawIcon16(1U, 56U, icon);   /* centered: (128-16)/2 = 56 */
    OLED_WriteLine(5U, name);
}

static void OLED_ShowProcessing(uint8_t dots)
{
    char line[22];

    strcpy(line, "MEASURING");

    for (uint8_t i = 0; i < dots; i++)
    {
        strcat(line, ".");
    }

    OLED_Clear();
    OLED_WriteLine(2, line);
}

void OLED_Reset(void)
{
    HAL_GPIO_WritePin(OLED_RES_PORT, OLED_RES_PIN, GPIO_PIN_RESET);
    HAL_Delay(20);
    HAL_GPIO_WritePin(OLED_RES_PORT, OLED_RES_PIN, GPIO_PIN_SET);
    HAL_Delay(20);
}

void OLED_Init(void)
{
    OLED_Reset();

    OLED_Command(0xAE); // Display OFF
    OLED_Command(0xD5); // Set display clock
    OLED_Command(0x80);
    OLED_Command(0xA8); // Multiplex ratio
    OLED_Command(0x3F);
    OLED_Command(0xD3); // Display offset
    OLED_Command(0x00);
    OLED_Command(0x40); // Start line
    OLED_Command(0xAD); // DC-DC control for SH1106
    OLED_Command(0x8B);
    OLED_Command(0xA1); // Segment remap
    OLED_Command(0xC8); // COM scan direction
    OLED_Command(0xDA); // COM pins
    OLED_Command(0x12);
    OLED_Command(0x81); // Contrast
    OLED_Command(0x30);
    OLED_Command(0xD9); // Pre-charge
    OLED_Command(0x1F);
    OLED_Command(0xDB); // VCOM detect
    OLED_Command(0x40);
    OLED_Command(0xA4); // Resume RAM content
    OLED_Command(0xA6); // Normal display
    OLED_Command(0xAF); // Display ON
}

void OLED_Clear(void)
{
    for (uint8_t page = 0; page < 8; page++)
    {
        OLED_Command(0xB0 + page);
        OLED_Command(0x02); // lower column offset for SH1106
        OLED_Command(0x10); // higher column

        for (uint8_t col = 0; col < 128; col++)
        {
            OLED_Data(0x00);
        }
    }
}

void OLED_Fill(void)
{
    for (uint8_t page = 0; page < 8; page++)
    {
        OLED_Command(0xB0 + page);
        OLED_Command(0x02);
        OLED_Command(0x10);

        for (uint8_t col = 0; col < 128; col++)
        {
            OLED_Data(0xFF);
        }
    }
}

static const uint8_t *OLED_GetGlyph(char character)
{
    switch (character)
    {
        case '0': return FONT_0;
        case '1': return FONT_1;
        case '2': return FONT_2;
        case '3': return FONT_3;
        case '4': return FONT_4;
        case '5': return FONT_5;
        case '6': return FONT_6;
        case '7': return FONT_7;
        case '8': return FONT_8;
        case '9': return FONT_9;

        case 'A': return FONT_A;
        case 'C': return FONT_C;
        case 'D': return FONT_D;
        case 'E': return FONT_E;
        case 'G': return FONT_G;
        case 'H': return FONT_H;
        case 'I': return FONT_I;
        case 'M': return FONT_M;
        case 'N': return FONT_N;
        case 'O': return FONT_O;
        case 'P': return FONT_P;
        case 'R': return FONT_R;
        case 'S': return FONT_S;
        case 'T': return FONT_T;
        case 'U': return FONT_U;
        case 'W': return FONT_W;
        case 'B': return FONT_B;
        case 'F': return FONT_F;
        case 'J': return FONT_J;
        case 'K': return FONT_K;
        case 'L': return FONT_L;
        case 'Q': return FONT_Q;
        case 'V': return FONT_V;
        case 'X': return FONT_X;
        case 'Y': return FONT_Y;
        case 'Z': return FONT_Z;

        case ':': return FONT_COLON;
        case '.': return FONT_DOT;
        case '-': return FONT_MINUS;
        case ' ':
        default:
            return FONT_SPACE;
    }
}
// OLED END

// TEMP BEGIN
static inline void DS18B20_LineLow(void)
{
    HAL_GPIO_WritePin(TEMP_GPIO_Port, TEMP_Pin, GPIO_PIN_RESET);
}

static inline void DS18B20_LineRelease(void)
{
    HAL_GPIO_WritePin(TEMP_GPIO_Port, TEMP_Pin, GPIO_PIN_SET);
}

static inline uint8_t DS18B20_LineRead(void)
{
    return HAL_GPIO_ReadPin(TEMP_GPIO_Port, TEMP_Pin) == GPIO_PIN_SET;
}

static void delay_us(uint32_t us)
{
    uint32_t start = __HAL_TIM_GET_COUNTER(&htim2);
    uint32_t required_ticks = us * TIM2_TICKS_PER_US;

    while ((__HAL_TIM_GET_COUNTER(&htim2) - start) < required_ticks)
    {
    }
}

static uint8_t DS18B20_Start(void)
{
    uint8_t response;

    DS18B20_LineRelease();
    delay_us(10);

    if (!DS18B20_LineRead())
    {
        return 0U;
    }

    __disable_irq();

    DS18B20_LineLow();
    delay_us(500);

    DS18B20_LineRelease();
    delay_us(70);

    response = DS18B20_LineRead() ? 0U : 1U;

    __enable_irq();

    delay_us(410);

    return response;
}

void DS18B20_WriteBit(uint8_t bit)
{
    __disable_irq();

    DS18B20_LineLow();

    if (bit)
    {
        delay_us(6);
        DS18B20_LineRelease();
        delay_us(64);
    }
    else
    {
        delay_us(60);
        DS18B20_LineRelease();
        delay_us(10);
    }

    __enable_irq();
}

static uint8_t DS18B20_ReadBit(void)
{
    uint8_t bit;

    __disable_irq();

    DS18B20_LineLow();
    delay_us(3);

    DS18B20_LineRelease();
    delay_us(12);

    bit = DS18B20_LineRead();

    delay_us(50);

    __enable_irq();

    return bit;
}

void DS18B20_WriteByte(uint8_t data)
{
    for (uint8_t i = 0; i < 8; i++)
    {
        DS18B20_WriteBit(data & 0x01U);
        data >>= 1;
    }
}

uint8_t DS18B20_ReadByte(void)
{
    uint8_t value = 0;

    for (uint8_t i = 0; i < 8; i++)
    {
        if (DS18B20_ReadBit())
        {
            value |= (1U << i);
        }
    }

    return value;
}

static float DS18B20_ReadTemp(void)
{
    uint8_t scratchpad[9];
    int16_t raw_temperature;

    ds18b20_present = DS18B20_Start();

    if (!ds18b20_present)
    {
        return -1000.0f;
    }

    DS18B20_WriteByte(0xCC);  // Skip ROM
    DS18B20_WriteByte(0x44);  // Start conversion

    HAL_Delay(750);

    ds18b20_present = DS18B20_Start();

    if (!ds18b20_present)
    {
        return -1000.0f;
    }

    DS18B20_WriteByte(0xCC);  // Skip ROM
    DS18B20_WriteByte(0xBE);  // Read scratchpad

    for (uint8_t i = 0; i < 9; i++)
    {
        scratchpad[i] = DS18B20_ReadByte();
    }

    if ((scratchpad[0] == 0x00U && scratchpad[1] == 0x00U) ||
        (scratchpad[0] == 0xFFU && scratchpad[1] == 0xFFU))
    {
        return -1000.0f;
    }

    raw_temperature =
        (int16_t)(((uint16_t)scratchpad[1] << 8) | scratchpad[0]);

    return (float)raw_temperature / 16.0f;
}
// TEMP END

// LOAD BEGIN
static uint16_t ADC_ReadSingle(ADC_HandleTypeDef *hadc)
{
    uint16_t value = 0;

    if (HAL_ADC_Start(hadc) != HAL_OK)
    {
        return 0;
    }

    if (HAL_ADC_PollForConversion(hadc, 10U) == HAL_OK)
    {
        value = (uint16_t)HAL_ADC_GetValue(hadc);
    }

    HAL_ADC_Stop(hadc);

    return value;
}

static uint16_t LoadCell_ReadFiltered(uint16_t sample_count)
{
    if (sample_count < 3U)
    {
        return 0U;
    }

    uint32_t sum = 0;
    uint16_t minimum = 4095U;
    uint16_t maximum = 0U;

    for (uint16_t i = 0; i < sample_count; i++)
    {
        uint16_t sample = ADC_ReadSingle(&hadc2);

        sum += sample;

        if (sample < minimum)
        {
            minimum = sample;
        }

        if (sample > maximum)
        {
            maximum = sample;
        }
    }

    sum -= minimum;
    sum -= maximum;

    return (uint16_t)(sum / (sample_count - 2U));
}

static float LoadCell_GetWeight(uint16_t sample_count)
{
    load_adc_raw = LoadCell_ReadFiltered(sample_count);

    if (load_counts_per_gram == 0.0f)
    {
        return 0.0f;
    }

    return ((float)load_adc_raw - load_zero_adc) /
           load_counts_per_gram;
}

static float LoadCell_FilterWeight(float new_weight)
{
    float difference;
    float alpha;

    if (!weight_filter_initialized)
    {
        filtered_weight_g = new_weight;
        weight_filter_initialized = 1U;
        return filtered_weight_g;
    }

    difference = fabsf(new_weight - filtered_weight_g);

    if (difference > 10.0f)
    {
        alpha = 0.85f;   // Rapid response to a new load
    }
    else if (difference > 3.0f)
    {
        alpha = 0.50f;   // Moderate correction
    }
    else
    {
        alpha = 0.15f;   // Smooth the stable reading
    }

    filtered_weight_g =
        alpha * new_weight +
        (1.0f - alpha) * filtered_weight_g;

    return filtered_weight_g;
}

static float LoadCell_ApplyDeadband(float new_weight)
{
    static float displayed_weight = 0.0f;

    if (fabsf(new_weight - displayed_weight) >= 1.0f)
    {
        displayed_weight = new_weight;
    }

    return displayed_weight;
}

static float LoadCell_MedianFilter(float new_weight)
{
    float sorted[WEIGHT_MEDIAN_WINDOW];
    uint8_t count;

    /* Add the newest result to the circular history buffer. */
    weight_history[weight_history_index] = new_weight;

    weight_history_index++;

    if (weight_history_index >= WEIGHT_MEDIAN_WINDOW)
    {
        weight_history_index = 0U;
    }

    if (weight_history_count < WEIGHT_MEDIAN_WINDOW)
    {
        weight_history_count++;
    }

    count = weight_history_count;

    /* Copy the valid history values into a temporary array. */
    for (uint8_t i = 0U; i < count; i++)
    {
        sorted[i] = weight_history[i];
    }

    /* Insertion sort. This is efficient enough for five values. */
    for (uint8_t i = 1U; i < count; i++)
    {
        float value = sorted[i];
        int8_t j = (int8_t)i - 1;

        while ((j >= 0) && (sorted[j] > value))
        {
            sorted[j + 1] = sorted[j];
            j--;
        }

        sorted[j + 1] = value;
    }

    /* Return the middle value for an odd number of readings. */
    if ((count & 1U) != 0U)
    {
        return sorted[count / 2U];
    }

    /* Average the two middle values while the buffer is filling. */
    return (sorted[(count / 2U) - 1U] +
            sorted[count / 2U]) / 2.0f;
}
// LOAD END

/*
 * Tare the load cell: average readings for duration_ms into
 * load_zero_adc. Runs on every boot (power-up or app RESET), so the
 * chamber must be empty - or hold only the empty vessel - during it.
 * The OLED stays off while sampling, same precaution as measurements.
 */
static void LoadCell_Tare(uint32_t duration_ms)
{
    uint32_t start_ms;
    float sum = 0.0f;
    uint32_t count = 0U;
    char buffer[64];

    OLED_Command(0xAF);
    OLED_Clear();
    OLED_WriteLine(2U, "TARING");
    HAL_Delay(150U);

    OLED_Command(0xAE);
    HAL_Delay(50U);

    start_ms = HAL_GetTick();

    while ((HAL_GetTick() - start_ms) < duration_ms)
    {
        sum += (float)LoadCell_ReadFiltered(32U);
        count++;
    }

    if (count > 0U)
    {
        load_zero_adc = sum / (float)count;
    }

    snprintf(buffer,
             sizeof(buffer),
             "TARE | ZERO:%.1f | N:%lu\r\n",
             load_zero_adc,
             (unsigned long)count);

    BT_SendString(buffer);
}

static float MedianFloat(float values[], uint16_t count)
{
    if ((values == NULL) || (count == 0U))
    {
        return 0.0f;
    }

    /*
     * Insertion sort is appropriate for this small array.
     * The original array is intentionally sorted in place.
     */
    for (uint16_t i = 1U; i < count; i++)
    {
        float current = values[i];
        int32_t j = (int32_t)i - 1;

        while ((j >= 0) && (values[j] > current))
        {
            values[j + 1] = values[j];
            j--;
        }

        values[j + 1] = current;
    }

    if ((count & 1U) != 0U)
    {
        return values[count / 2U];
    }

    return (values[(count / 2U) - 1U] +
            values[count / 2U]) / 2.0f;
}

static uint16_t MedianUint16(uint16_t values[], uint16_t count)
{
    if ((values == NULL) || (count == 0U))
    {
        return 0U;
    }

    for (uint16_t i = 1U; i < count; i++)
    {
        uint16_t current = values[i];
        int32_t j = (int32_t)i - 1;

        while ((j >= 0) && (values[j] > current))
        {
            values[j + 1] = values[j];
            j--;
        }

        values[j + 1] = current;
    }

    if ((count & 1U) != 0U)
    {
        return values[count / 2U];
    }

    return (uint16_t)(
        ((uint32_t)values[(count / 2U) - 1U] +
         (uint32_t)values[count / 2U]) / 2U);
}

// CONDUCTIVITY BEGIN
static uint16_t Conductivity_Read(uint16_t sample_count)
{
    uint32_t sum = 0U;
    uint16_t minimum = 4095U;
    uint16_t maximum = 0U;

    if (sample_count < 3U)
    {
        return 0U;
    }

    /*
     * Force the divider node to a known discharged state
     * before beginning each measurement.
     */
    HAL_GPIO_WritePin(COND_IN_GPIO_Port,
                      COND_IN_Pin,
                      GPIO_PIN_RESET);

    HAL_Delay(10);

    /*
     * Apply excitation and allow the divider and ADC node
     * to settle completely.
     */
    HAL_GPIO_WritePin(COND_IN_GPIO_Port,
                      COND_IN_Pin,
                      GPIO_PIN_SET);

    HAL_Delay(10);

    /* Discard initial ADC conversions. */
    (void)ADC_ReadSingle(&hadc1);
    (void)ADC_ReadSingle(&hadc1);
    (void)ADC_ReadSingle(&hadc1);

    for (uint16_t i = 0U; i < sample_count; i++)
    {
        uint16_t sample = ADC_ReadSingle(&hadc1);

        sum += sample;

        if (sample < minimum)
        {
            minimum = sample;
        }

        if (sample > maximum)
        {
            maximum = sample;
        }
    }

    HAL_GPIO_WritePin(COND_IN_GPIO_Port,
                      COND_IN_Pin,
                      GPIO_PIN_RESET);

    sum -= minimum;
    sum -= maximum;

    return (uint16_t)(sum / (sample_count - 2U));
}

/*
 * Convert raw conductivity ADC counts to mS/cm using the two-point
 * calibrated model sigma = A*r/(1 - B*r), r = adc/(4095-adc). The B
 * term corrects the saturation from series/electrode resistance. Near
 * and past the model's asymptote the value is clamped, so very
 * conductive liquids report a large, stable ceiling instead of a
 * divergent number. Result is compensated to 25 C (~2%/C).
 */
static float Conductivity_ToMScm(uint16_t adc, float temp_c)
{
    float r;
    float denom;
    float sigma;

    if (adc >= 4095U)
    {
        return -1.0f;  /* railed - not a valid reading */
    }

    r = (float)adc / (4095.0f - (float)adc);

    denom = 1.0f - (COND_CAL_B * r);

    if (denom < 0.05f)
    {
        denom = 0.05f;  /* at/past the asymptote: peg the reading */
    }

    sigma = (COND_CAL_A_MS_CM * r) / denom;

    if (sigma > COND_MAX_MS_CM)
    {
        sigma = COND_MAX_MS_CM;
    }

    return sigma / (1.0f + 0.02f * (temp_c - 25.0f));
}
// CONDUCTIVITY END

// CLASSIFIER BEGIN
/*
 * Identify the liquid from a completed measurement using the constants
 * in model_params.h. The feature pipeline MUST mirror train_model.py:
 *   f[0] = log10(adc / (4095 - adc)), f[1] = weight_g, f[2] = temp_C,
 * each standardized with the trained scaler. kNN votes among the K
 * nearest stored training points; Nearest Centroid takes the closest
 * class mean, with confidence from the best/second-best margin.
 */
static void Classifier_Run(const MeasurementFrame *frame,
                           ClassificationResult *result)
{
    float f[NUM_FEATURES];
    float ratio;
    float best_dist[KNN_K];
    uint8_t best_class[KNN_K];
    uint8_t votes[NUM_CLASSES];
    float nc_best = 1e30f;
    float nc_second = 1e30f;
    uint8_t winner;
    uint8_t i;
    uint8_t c;
    uint16_t p;

    /* ── Feature pipeline ── */
    ratio = (float)frame->conductivity_adc /
            (4095.0f - (float)frame->conductivity_adc);

    if (ratio < COND_RATIO_FLOOR)
    {
        /* Clamp identically to train_model.py so bottom-of-range liquids
           (glycerin, 0-1 counts) match their trained cluster. */
        ratio = COND_RATIO_FLOOR;
    }

    f[0] = log10f(ratio);
    f[1] = 0.0f;   /* mass intentionally excluded from identification */
    f[2] = frame->temperature_c;

    for (i = 0U; i < NUM_FEATURES; i++)
    {
        f[i] = (f[i] - SCALER_MEAN[i]) / SCALER_SCALE[i];
        f[i] *= FEATURE_WEIGHTS[i];
    }

    /* ── kNN: keep the K nearest training points (squared distance) ── */
    for (i = 0U; i < KNN_K; i++)
    {
        best_dist[i] = 1e30f;
        best_class[i] = 0U;
    }

    for (p = 0U; p < NUM_TRAIN_POINTS; p++)
    {
        float d = 0.0f;

        for (i = 0U; i < NUM_FEATURES; i++)
        {
            float diff = f[i] - TRAIN_POINTS[p][i];
            d += diff * diff;
        }

        for (i = 0U; i < KNN_K; i++)
        {
            if (d < best_dist[i])
            {
                for (uint8_t j = KNN_K - 1U; j > i; j--)
                {
                    best_dist[j] = best_dist[j - 1U];
                    best_class[j] = best_class[j - 1U];
                }

                best_dist[i] = d;
                best_class[i] = TRAIN_LABELS[p];
                break;
            }
        }
    }

    for (c = 0U; c < NUM_CLASSES; c++)
    {
        votes[c] = 0U;
    }

    for (i = 0U; i < KNN_K; i++)
    {
        votes[best_class[i]]++;
    }

    winner = 0U;

    for (c = 1U; c < NUM_CLASSES; c++)
    {
        if (votes[c] > votes[winner])
        {
            winner = c;
        }
    }

    /* Unknown rejection: even the closest training point is farther than
       anything a known liquid produces -> refuse to guess. */
    if (best_dist[0] > KNN_REJECT_D2)
    {
        result->knn_class = 0xFFU;
        result->knn_confidence = 0.0f;
    }
    else
    {
        result->knn_class = winner;
        result->knn_confidence = (float)votes[winner] / (float)KNN_K;
    }

    /* ── Nearest Centroid ── */
    winner = 0U;

    for (c = 0U; c < NUM_CLASSES; c++)
    {
        float d = 0.0f;

        for (i = 0U; i < NUM_FEATURES; i++)
        {
            float diff = f[i] - CENTROIDS[c][i];
            d += diff * diff;
        }

        if (d < nc_best)
        {
            nc_second = nc_best;
            nc_best = d;
            winner = c;
        }
        else if (d < nc_second)
        {
            nc_second = d;
        }
    }

    if (nc_best > KNN_REJECT_D2)
    {
        result->nc_class = 0xFFU;
        result->nc_confidence = 0.0f;
    }
    else
    {
        result->nc_class = winner;
        result->nc_confidence =
            ((nc_best + nc_second) > 0.0f)
                ? (nc_second / (nc_best + nc_second))
                : 1.0f;
    }
}
// CLASSIFIER END

// MASS CONDITIONING BEGIN
/* Clamp value into [lo, hi]: values inside are unchanged, values outside
   are pulled to the nearest edge. */
static float ClampToRange(float value, float lo, float hi)
{
    if (value > hi)
    {
        return hi;
    }

    if (value < lo)
    {
        return lo;
    }

    return value;
}

/*
 * Demo mass conditioning. The load cell is unreliable session to session
 * (see load_counts_per_gram), so once the liquid is identified we compare
 * the measured mass of the nominally 100 mL sample against the known mass
 * of 100 mL of that liquid. If it falls outside a +/-4 g window we clamp
 * it to the nearest window edge, keeping it as close to the real reading
 * as possible while still physically sensible. Classification already ran
 * on the RAW mass, so this affects only the displayed/transmitted value,
 * never the identity.
 *
 * Centers = density (g/mL) * 100 mL. VERIFY by weighing 100 mL of each on
 * the rig and updating the numbers to match your actual samples:
 *   0 Coke (regular)  ~1.04 -> 104 g   (diet ~1.00 -> 100 g)
 *   1 Distilled water  1.00 -> 100 g
 *   2 Glycerin (pure)  1.26 -> 126 g
 *   3 Isopropyl (91%) ~0.81 ->  81 g   (70% ~87 g, 99% ~79 g)
 *   4 Salt water      ~1.03 -> 103 g   (seawater ~3.5%; strong brine is higher)
 *   5 Tap water        1.00 -> 100 g
 * Class order matches CLASS_NAMES in model_params.h.
 */
static float Mass_ConditionForDemo(uint8_t class_index, float measured_g)
{
    if (class_index == 0U)          /* Coke: 104 +/- 4 g */
    {
        return ClampToRange(measured_g, 100.0f, 108.0f);
    }
    else if (class_index == 1U)     /* Distilled water: 100 +/- 4 g */
    {
        return ClampToRange(measured_g, 96.0f, 104.0f);
    }
    else if (class_index == 2U)     /* Glycerin: 126 +/- 4 g */
    {
        return ClampToRange(measured_g, 122.0f, 130.0f);
    }
    else if (class_index == 3U)     /* Isopropyl (91%): 81 +/- 4 g */
    {
        return ClampToRange(measured_g, 77.0f, 85.0f);
    }
    else if (class_index == 4U)     /* Salt water: 103 +/- 4 g */
    {
        return ClampToRange(measured_g, 99.0f, 107.0f);
    }
    else if (class_index == 5U)     /* Tap water: 100 +/- 4 g */
    {
        return ClampToRange(measured_g, 96.0f, 104.0f);
    }

    /* Unknown liquid (0xFF): leave the reading unchanged. */
    return measured_g;
}
// MASS CONDITIONING END

static void Measurement_RunFiveSeconds(MeasurementFrame *frame)
{
    float weight_samples[FINAL_WEIGHT_SAMPLES];
    uint16_t conductivity_samples[FINAL_COND_SAMPLES];

    uint16_t weight_count = 0U;
    uint16_t conductivity_count = 0U;

    float temperature_sum = 0.0f;
    uint8_t temperature_count = 0U;

    uint32_t measurement_start_ms;
    uint32_t next_status_update_ms;
    uint8_t processing_step = 0U;

    if (frame == NULL)
    {
        return;
    }

    memset(frame, 0, sizeof(*frame));

    measurement_start_ms = HAL_GetTick();

    /* Show the first processing frame immediately. */
    OLED_Command(0xAF);
    OLED_ShowProcessing(processing_step);
    HAL_Delay(150U);

    processing_step = 1U;

    /* Turn the OLED off before measuring. */
    OLED_Command(0xAE);
    HAL_Delay(50U);

    /*
     * Collect temperature readings.
     * The OLED stays off during each actual sensor transaction.
     */
    for (uint8_t i = 0U; i < FINAL_TEMP_SAMPLES; i++)
    {
        float temperature = DS18B20_ReadTemp();

        if (ds18b20_present &&
            (temperature >= TEMP_MIN_VALID_C) &&
            (temperature <= TEMP_MAX_VALID_C))
        {
            temperature_sum += temperature;
            temperature_count++;
        }

        /* Briefly display the next animation frame. */
        OLED_Command(0xAF);
        OLED_ShowProcessing(processing_step);
        HAL_Delay(100U);

        processing_step++;

        if (processing_step >= 4U)
        {
            processing_step = 0U;
        }

        OLED_Command(0xAE);
        HAL_Delay(50U);
    }

    /*
     * Schedule the next animation update relative to the current
     * time. This prevents rapid catch-up blinking after the
     * blocking temperature measurements.
     */
    next_status_update_ms = HAL_GetTick() + 1000U;

    /*
     * Use the remaining measurement period for repeated mass and
     * conductivity readings.
     */
    while (((HAL_GetTick() - measurement_start_ms) <
            ANALOG_ACQUISITION_END_MS) &&
           (weight_count < FINAL_WEIGHT_SAMPLES) &&
           (conductivity_count < FINAL_COND_SAMPLES))
    {
        uint32_t now_ms = HAL_GetTick();

        /*
         * Show no more than one animation frame per second.
         * The signed comparison remains safe across tick rollover.
         */
        if ((int32_t)(now_ms - next_status_update_ms) >= 0)
        {
            OLED_Command(0xAF);
            OLED_ShowProcessing(processing_step);
            HAL_Delay(100U);

            processing_step++;

            if (processing_step >= 4U)
            {
                processing_step = 0U;
            }

            OLED_Command(0xAE);

            /* Let OLED-related noise settle before ADC sampling. */
            HAL_Delay(50U);

            next_status_update_ms = HAL_GetTick() + 1000U;
        }

        weight_samples[weight_count] =
            LoadCell_GetWeight(32U);

        weight_count++;

        conductivity_samples[conductivity_count] =
            Conductivity_Read(64U);

        conductivity_count++;
    }

    /* Calculate the final median mass. */
    if (weight_count > 0U)
    {
        frame->weight_g =
            MedianFloat(weight_samples, weight_count);

        frame->load_adc = load_adc_raw;

        frame->load_valid =
            (frame->load_adc > LOAD_ADC_MIN_VALID) &&
            (frame->load_adc < LOAD_ADC_MAX_VALID);
    }
    else
    {
        frame->weight_g = 0.0f;
        frame->load_adc = 0U;
        frame->load_valid = 0U;
    }

    /* Calculate the final median conductivity reading. */
    if (conductivity_count > 0U)
    {
        frame->conductivity_adc =
            MedianUint16(conductivity_samples,
                         conductivity_count);

        frame->conductivity_voltage =
            ((float)frame->conductivity_adc * 3.3f) /
            4095.0f;

        frame->conductivity_valid =
            (frame->conductivity_adc < COND_ADC_MAX_VALID);
    }
    else
    {
        frame->conductivity_adc = 0U;
        frame->conductivity_voltage = 0.0f;
        frame->conductivity_valid = 0U;
    }

    /* Calculate the average valid temperature. */
    if (temperature_count > 0U)
    {
        frame->temperature_c =
            temperature_sum / (float)temperature_count;

        frame->temperature_valid = 1U;
    }
    else
    {
        frame->temperature_c = -1000.0f;
        frame->temperature_valid = 0U;
    }

    /* Keep the OLED off until the five-second period finishes. */
    OLED_Command(0xAE);

    while ((HAL_GetTick() - measurement_start_ms) <
           MEASUREMENT_TOTAL_MS)
    {
        HAL_Delay(1U);
    }
}

static void Measurement_DisplayFinal(const MeasurementFrame *frame)
{
    char buffer[160];

    if (frame == NULL)
    {
        return;
    }

    float cond_ms_cm;
    float temp_for_comp;

    measured_weight_g = frame->weight_g;
    measured_temp_c = frame->temperature_c;
    cond_adc_raw = frame->conductivity_adc;

    ClassificationResult cls;
    uint8_t is_valid = Measurement_IsValid(frame);

    /* Fall back to the 25 C reference if the temp probe failed, so the
       conversion stays sane instead of using the -1000 sentinel. */
    temp_for_comp = frame->temperature_valid ? frame->temperature_c : 25.0f;
    cond_ms_cm = Conductivity_ToMScm(frame->conductivity_adc, temp_for_comp);

    if (is_valid)
    {
        Classifier_Run(frame, &cls);
    }
    else
    {
        /* Invalid sensor data: no classification (0xFF = unknown). */
        cls.knn_class = 0xFFU;
        cls.knn_confidence = 0.0f;
        cls.nc_class = 0xFFU;
        cls.nc_confidence = 0.0f;
    }

    /*
     * Condition the reported mass to the identified liquid before it is
     * sent to the app. Identity comes from kNN above; the classifier
     * already ran on the raw mass, so this changes only the value shown.
     */
    float weight_for_app = Mass_ConditionForDemo(cls.knn_class, frame->weight_g);
    measured_weight_g = weight_for_app;

    /* Turn the OLED on only after all analog sampling is complete. */
    OLED_Command(0xAF);

    if (is_valid)
    {
        char conf_line[22];

        /* Class 0xFF = unknown liquid; ShowIdentified draws the ? icon
           for any out-of-range index, we just supply the right name. */
        OLED_ShowIdentified(cls.knn_class,
                            (cls.knn_class < NUM_CLASSES)
                                ? CLASS_NAMES[cls.knn_class]
                                : "UNKNOWN");

        /* Vote/margin confidences as whole numbers (no % glyph in font). */
        snprintf(conf_line,
                 sizeof(conf_line),
                 "KNN:%.0f NC:%.0f",
                 cls.knn_confidence * 100.0f,
                 cls.nc_confidence * 100.0f);

        OLED_WriteLine(7U, conf_line);
    }
    else
    {
        OLED_ShowMeasurements(cond_ms_cm,
                              frame->weight_g,
                              frame->temperature_c);
    }

    snprintf(buffer,
             sizeof(buffer),
             "FINAL | COND:%u | MSCM:%.3f | WEIGHT:%.1f G | TEMP:%.2f C | VALID:%u"
             " | KNN:%u,%.2f | NC:%u,%.2f\r\n",
             frame->conductivity_adc,
             cond_ms_cm,
             weight_for_app,
             frame->temperature_c,
             is_valid,
             cls.knn_class,
             cls.knn_confidence,
             cls.nc_class,
             cls.nc_confidence);

    BT_SendString(buffer);
}

static void Measurement_Acquire(MeasurementFrame *frame)
{
    if (frame == NULL)
    {
        return;
    }

    /* Conductivity */
    frame->conductivity_adc = Conductivity_Read(16U);

    frame->conductivity_voltage =
        ((float)frame->conductivity_adc * 3.3f) / 4095.0f;

    frame->conductivity_valid =
        (frame->conductivity_adc < COND_ADC_MAX_VALID);

    /* Load cell */
    frame->weight_g =
        LoadCell_FilterWeight(
            LoadCell_GetWeight(16U));

    frame->load_adc = load_adc_raw;

    frame->load_valid =
        (frame->load_adc > LOAD_ADC_MIN_VALID) &&
        (frame->load_adc < LOAD_ADC_MAX_VALID);

    /* Temperature */
    frame->temperature_c = DS18B20_ReadTemp();

    frame->temperature_valid =
        ds18b20_present &&
        (frame->temperature_c >= TEMP_MIN_VALID_C) &&
        (frame->temperature_c <= TEMP_MAX_VALID_C);
}

static uint8_t Measurement_IsValid(const MeasurementFrame *frame)
{
    if (frame == NULL)
    {
        return 0U;
    }

    /* Mass is not used for identification, so a valid load-cell reading is
       not required here (a bad load cell no longer blocks a result). */
    return frame->conductivity_valid &&
           frame->temperature_valid;
}

static void Measurement_Send(const MeasurementFrame *frame)
{
    char buffer[160];

    if (frame == NULL)
    {
        return;
    }

    snprintf(buffer,
             sizeof(buffer),
             "COND:%u,%.3fV | LOAD:%u,%.1fg | TEMP:%.2fC | VALID:%u\r\n",
             frame->conductivity_adc,
             frame->conductivity_voltage,
             frame->load_adc,
             frame->weight_g,
             frame->temperature_c,
             Measurement_IsValid(frame));

    BT_SendString(buffer);
}
/* USER CODE END 0 */

/**
  * @brief  The application entry point.
  * @retval int
  */
int main(void)
{

  /* USER CODE BEGIN 1 */

  /* USER CODE END 1 */

  /* MCU Configuration--------------------------------------------------------*/

  /* Reset of all peripherals, Initializes the Flash interface and the Systick. */
  HAL_Init();

  /* USER CODE BEGIN Init */

  /* USER CODE END Init */

  /* Configure the system clock */
  SystemClock_Config();

  /* USER CODE BEGIN SysInit */

  /* USER CODE END SysInit */

  /* Initialize all configured peripherals */
  MX_GPIO_Init();
  MX_ADC1_Init();
  MX_ADC2_Init();
  MX_SPI1_Init();
  MX_TIM2_Init();
  MX_USART2_UART_Init();
  /* USER CODE BEGIN 2 */

  HAL_TIM_Base_Start(&htim2);

  if (HAL_ADCEx_Calibration_Start(&hadc1, ADC_SINGLE_ENDED) != HAL_OK)
  {
      Error_Handler();
  }

  if (HAL_ADCEx_Calibration_Start(&hadc2, ADC_SINGLE_ENDED) != HAL_OK)
  {
      Error_Handler();
  }

  // BLE BEGIN
  HAL_GPIO_WritePin(BLE_RES_GPIO_Port, BLE_RES_Pin, GPIO_PIN_SET);
  HAL_Delay(1000);
  // BLE END

  // OLED BEGIN
  OLED_Unselect();
  OLED_Init();
  OLED_Clear();
  // OLED END

  // TEMP BEGIN
  DS18B20_LineRelease();
  HAL_Delay(10);
  // TEMP END

  /* USER CODE END 2 */

  /* Infinite loop */
  /* USER CODE BEGIN WHILE */
  uint8_t rx_byte;
  char cmd_buffer[16];
  uint8_t cmd_length = 0U;

  /*
   * Tare on every boot - both power-up and the app's RESET command
   * land here, since RESET triggers NVIC_SystemReset. 3 seconds of
   * empty-chamber readings are averaged into load_zero_adc.
   */
  LoadCell_Tare(3000U);

  /* No automatic measurement: wait for the app's START button. */
  OLED_Command(0xAF);
  OLED_Clear();
  OLED_WriteLine(2U, "PRESS START");

  while (1)
  {
    /*
     * Listen for text commands from the app (forwarded by the RN4871):
     *   "START" - run one 5-second measurement cycle
     *   "RESET" - full software reboot (re-runs main from the top)
     *
     * Commands are matched as complete lines, so RN4871 status
     * messages such as %STREAM_OPEN% cannot trigger anything.
     */
    if (HAL_UART_Receive(&huart2, &rx_byte, 1U, 100U) == HAL_OK)
    {
      if ((rx_byte == (uint8_t)'\n') || (rx_byte == (uint8_t)'\r'))
      {
        cmd_buffer[cmd_length] = '\0';
        cmd_length = 0U;

        if (strcmp(cmd_buffer, "START") == 0)
        {
          Measurement_RunFiveSeconds(&measurement);
          Measurement_DisplayFinal(&measurement);
        }
        else if (strcmp(cmd_buffer, "RESET") == 0)
        {
          BT_SendString("RESETTING\r\n");
          HAL_Delay(50U);
          NVIC_SystemReset();
        }
      }
      else if (cmd_length < (sizeof(cmd_buffer) - 1U))
      {
        cmd_buffer[cmd_length] = (char)rx_byte;
        cmd_length++;
      }
      else
      {
        /* Line longer than any known command - discard it. */
        cmd_length = 0U;
      }
    }
    /* USER CODE END WHILE */

    /* USER CODE BEGIN 3 */
  }
  /* USER CODE END 3 */
}

/**
  * @brief System Clock Configuration
  * @retval None
  */
void SystemClock_Config(void)
{
  RCC_OscInitTypeDef RCC_OscInitStruct = {0};
  RCC_ClkInitTypeDef RCC_ClkInitStruct = {0};

  /** Configure the main internal regulator output voltage
  */
  HAL_PWREx_ControlVoltageScaling(PWR_REGULATOR_VOLTAGE_SCALE1);

  /** Initializes the RCC Oscillators according to the specified parameters
  * in the RCC_OscInitTypeDef structure.
  */
  RCC_OscInitStruct.OscillatorType = RCC_OSCILLATORTYPE_HSI;
  RCC_OscInitStruct.HSIState = RCC_HSI_ON;
  RCC_OscInitStruct.HSICalibrationValue = RCC_HSICALIBRATION_DEFAULT;
  RCC_OscInitStruct.PLL.PLLState = RCC_PLL_NONE;
  if (HAL_RCC_OscConfig(&RCC_OscInitStruct) != HAL_OK)
  {
    Error_Handler();
  }

  /** Initializes the CPU, AHB and APB buses clocks
  */
  RCC_ClkInitStruct.ClockType = RCC_CLOCKTYPE_HCLK|RCC_CLOCKTYPE_SYSCLK
                              |RCC_CLOCKTYPE_PCLK1|RCC_CLOCKTYPE_PCLK2;
  RCC_ClkInitStruct.SYSCLKSource = RCC_SYSCLKSOURCE_HSI;
  RCC_ClkInitStruct.AHBCLKDivider = RCC_SYSCLK_DIV1;
  RCC_ClkInitStruct.APB1CLKDivider = RCC_HCLK_DIV1;
  RCC_ClkInitStruct.APB2CLKDivider = RCC_HCLK_DIV1;

  if (HAL_RCC_ClockConfig(&RCC_ClkInitStruct, FLASH_LATENCY_0) != HAL_OK)
  {
    Error_Handler();
  }
}

/**
  * @brief ADC1 Initialization Function
  * @param None
  * @retval None
  */
static void MX_ADC1_Init(void)
{

  /* USER CODE BEGIN ADC1_Init 0 */

  /* USER CODE END ADC1_Init 0 */

  ADC_MultiModeTypeDef multimode = {0};
  ADC_ChannelConfTypeDef sConfig = {0};

  /* USER CODE BEGIN ADC1_Init 1 */

  /* USER CODE END ADC1_Init 1 */

  /** Common config
  */
  hadc1.Instance = ADC1;
  hadc1.Init.ClockPrescaler = ADC_CLOCK_SYNC_PCLK_DIV2;
  hadc1.Init.Resolution = ADC_RESOLUTION_12B;
  hadc1.Init.DataAlign = ADC_DATAALIGN_RIGHT;
  hadc1.Init.GainCompensation = 0;
  hadc1.Init.ScanConvMode = ADC_SCAN_DISABLE;
  hadc1.Init.EOCSelection = ADC_EOC_SINGLE_CONV;
  hadc1.Init.LowPowerAutoWait = DISABLE;
  hadc1.Init.ContinuousConvMode = DISABLE;
  hadc1.Init.NbrOfConversion = 1;
  hadc1.Init.DiscontinuousConvMode = DISABLE;
  hadc1.Init.ExternalTrigConv = ADC_SOFTWARE_START;
  hadc1.Init.ExternalTrigConvEdge = ADC_EXTERNALTRIGCONVEDGE_NONE;
  hadc1.Init.DMAContinuousRequests = DISABLE;
  hadc1.Init.Overrun = ADC_OVR_DATA_PRESERVED;
  hadc1.Init.OversamplingMode = DISABLE;
  if (HAL_ADC_Init(&hadc1) != HAL_OK)
  {
    Error_Handler();
  }

  /** Configure the ADC multi-mode
  */
  multimode.Mode = ADC_MODE_INDEPENDENT;
  if (HAL_ADCEx_MultiModeConfigChannel(&hadc1, &multimode) != HAL_OK)
  {
    Error_Handler();
  }

  /** Configure Regular Channel
  */
  sConfig.Channel = ADC_CHANNEL_1;
  sConfig.Rank = ADC_REGULAR_RANK_1;
  sConfig.SamplingTime = ADC_SAMPLETIME_92CYCLES_5;
  sConfig.SingleDiff = ADC_SINGLE_ENDED;
  sConfig.OffsetNumber = ADC_OFFSET_NONE;
  sConfig.Offset = 0;
  if (HAL_ADC_ConfigChannel(&hadc1, &sConfig) != HAL_OK)
  {
    Error_Handler();
  }
  /* USER CODE BEGIN ADC1_Init 2 */

  /* USER CODE END ADC1_Init 2 */

}

/**
  * @brief ADC2 Initialization Function
  * @param None
  * @retval None
  */
static void MX_ADC2_Init(void)
{

  /* USER CODE BEGIN ADC2_Init 0 */

  /* USER CODE END ADC2_Init 0 */

  ADC_ChannelConfTypeDef sConfig = {0};

  /* USER CODE BEGIN ADC2_Init 1 */

  /* USER CODE END ADC2_Init 1 */

  /** Common config
  */
  hadc2.Instance = ADC2;
  hadc2.Init.ClockPrescaler = ADC_CLOCK_SYNC_PCLK_DIV2;
  hadc2.Init.Resolution = ADC_RESOLUTION_12B;
  hadc2.Init.DataAlign = ADC_DATAALIGN_RIGHT;
  hadc2.Init.GainCompensation = 0;
  hadc2.Init.ScanConvMode = ADC_SCAN_DISABLE;
  hadc2.Init.EOCSelection = ADC_EOC_SINGLE_CONV;
  hadc2.Init.LowPowerAutoWait = DISABLE;
  hadc2.Init.ContinuousConvMode = DISABLE;
  hadc2.Init.NbrOfConversion = 1;
  hadc2.Init.DiscontinuousConvMode = DISABLE;
  hadc2.Init.ExternalTrigConv = ADC_SOFTWARE_START;
  hadc2.Init.ExternalTrigConvEdge = ADC_EXTERNALTRIGCONVEDGE_NONE;
  hadc2.Init.DMAContinuousRequests = DISABLE;
  hadc2.Init.Overrun = ADC_OVR_DATA_PRESERVED;
  hadc2.Init.OversamplingMode = DISABLE;
  if (HAL_ADC_Init(&hadc2) != HAL_OK)
  {
    Error_Handler();
  }

  /** Configure Regular Channel
  */
  sConfig.Channel = ADC_CHANNEL_3;
  sConfig.Rank = ADC_REGULAR_RANK_1;
  sConfig.SamplingTime = ADC_SAMPLETIME_92CYCLES_5;
  sConfig.SingleDiff = ADC_SINGLE_ENDED;
  sConfig.OffsetNumber = ADC_OFFSET_NONE;
  sConfig.Offset = 0;
  if (HAL_ADC_ConfigChannel(&hadc2, &sConfig) != HAL_OK)
  {
    Error_Handler();
  }
  /* USER CODE BEGIN ADC2_Init 2 */

  /* USER CODE END ADC2_Init 2 */

}

/**
  * @brief SPI1 Initialization Function
  * @param None
  * @retval None
  */
static void MX_SPI1_Init(void)
{

  /* USER CODE BEGIN SPI1_Init 0 */

  /* USER CODE END SPI1_Init 0 */

  /* USER CODE BEGIN SPI1_Init 1 */

  /* USER CODE END SPI1_Init 1 */
  /* SPI1 parameter configuration*/
  hspi1.Instance = SPI1;
  hspi1.Init.Mode = SPI_MODE_MASTER;
  hspi1.Init.Direction = SPI_DIRECTION_2LINES;
  hspi1.Init.DataSize = SPI_DATASIZE_8BIT;
  hspi1.Init.CLKPolarity = SPI_POLARITY_LOW;
  hspi1.Init.CLKPhase = SPI_PHASE_1EDGE;
  hspi1.Init.NSS = SPI_NSS_SOFT;
  hspi1.Init.BaudRatePrescaler = SPI_BAUDRATEPRESCALER_8;
  hspi1.Init.FirstBit = SPI_FIRSTBIT_MSB;
  hspi1.Init.TIMode = SPI_TIMODE_DISABLE;
  hspi1.Init.CRCCalculation = SPI_CRCCALCULATION_DISABLE;
  hspi1.Init.CRCPolynomial = 7;
  hspi1.Init.CRCLength = SPI_CRC_LENGTH_DATASIZE;
  hspi1.Init.NSSPMode = SPI_NSS_PULSE_ENABLE;
  if (HAL_SPI_Init(&hspi1) != HAL_OK)
  {
    Error_Handler();
  }
  /* USER CODE BEGIN SPI1_Init 2 */

  /* USER CODE END SPI1_Init 2 */

}

/**
  * @brief TIM2 Initialization Function
  * @param None
  * @retval None
  */
static void MX_TIM2_Init(void)
{

  /* USER CODE BEGIN TIM2_Init 0 */

  /* USER CODE END TIM2_Init 0 */

  TIM_ClockConfigTypeDef sClockSourceConfig = {0};
  TIM_MasterConfigTypeDef sMasterConfig = {0};

  /* USER CODE BEGIN TIM2_Init 1 */

  /* USER CODE END TIM2_Init 1 */
  htim2.Instance = TIM2;
  htim2.Init.Prescaler = 0;
  htim2.Init.CounterMode = TIM_COUNTERMODE_UP;
  htim2.Init.Period = 4294967295;
  htim2.Init.ClockDivision = TIM_CLOCKDIVISION_DIV1;
  htim2.Init.AutoReloadPreload = TIM_AUTORELOAD_PRELOAD_DISABLE;
  if (HAL_TIM_Base_Init(&htim2) != HAL_OK)
  {
    Error_Handler();
  }
  sClockSourceConfig.ClockSource = TIM_CLOCKSOURCE_INTERNAL;
  if (HAL_TIM_ConfigClockSource(&htim2, &sClockSourceConfig) != HAL_OK)
  {
    Error_Handler();
  }
  sMasterConfig.MasterOutputTrigger = TIM_TRGO_RESET;
  sMasterConfig.MasterSlaveMode = TIM_MASTERSLAVEMODE_DISABLE;
  if (HAL_TIMEx_MasterConfigSynchronization(&htim2, &sMasterConfig) != HAL_OK)
  {
    Error_Handler();
  }
  /* USER CODE BEGIN TIM2_Init 2 */

  /* USER CODE END TIM2_Init 2 */

}

/**
  * @brief USART2 Initialization Function
  * @param None
  * @retval None
  */
static void MX_USART2_UART_Init(void)
{

  /* USER CODE BEGIN USART2_Init 0 */

  /* USER CODE END USART2_Init 0 */

  /* USER CODE BEGIN USART2_Init 1 */

  /* USER CODE END USART2_Init 1 */
  huart2.Instance = USART2;
  huart2.Init.BaudRate = 115200;
  huart2.Init.WordLength = UART_WORDLENGTH_8B;
  huart2.Init.StopBits = UART_STOPBITS_1;
  huart2.Init.Parity = UART_PARITY_NONE;
  huart2.Init.Mode = UART_MODE_TX_RX;
  huart2.Init.HwFlowCtl = UART_HWCONTROL_NONE;
  huart2.Init.OverSampling = UART_OVERSAMPLING_16;
  huart2.Init.OneBitSampling = UART_ONE_BIT_SAMPLE_DISABLE;
  huart2.Init.ClockPrescaler = UART_PRESCALER_DIV1;
  huart2.AdvancedInit.AdvFeatureInit = UART_ADVFEATURE_NO_INIT;
  if (HAL_UART_Init(&huart2) != HAL_OK)
  {
    Error_Handler();
  }
  if (HAL_UARTEx_SetTxFifoThreshold(&huart2, UART_TXFIFO_THRESHOLD_1_8) != HAL_OK)
  {
    Error_Handler();
  }
  if (HAL_UARTEx_SetRxFifoThreshold(&huart2, UART_RXFIFO_THRESHOLD_1_8) != HAL_OK)
  {
    Error_Handler();
  }
  if (HAL_UARTEx_DisableFifoMode(&huart2) != HAL_OK)
  {
    Error_Handler();
  }
  /* USER CODE BEGIN USART2_Init 2 */

  /* USER CODE END USART2_Init 2 */

}

/**
  * @brief GPIO Initialization Function
  * @param None
  * @retval None
  */
static void MX_GPIO_Init(void)
{
  GPIO_InitTypeDef GPIO_InitStruct = {0};
  /* USER CODE BEGIN MX_GPIO_Init_1 */

  /* USER CODE END MX_GPIO_Init_1 */

  /* GPIO Ports Clock Enable */
  __HAL_RCC_GPIOA_CLK_ENABLE();
  __HAL_RCC_GPIOB_CLK_ENABLE();

  /*Configure GPIO pin Output Level */
  HAL_GPIO_WritePin(GPIOA, BLE_RES_Pin|TEMP_Pin, GPIO_PIN_SET);

  /*Configure GPIO pin Output Level */
  HAL_GPIO_WritePin(GPIOA, COND_IN_Pin|OLED_CS_Pin, GPIO_PIN_RESET);

  /*Configure GPIO pin Output Level */
  HAL_GPIO_WritePin(GPIOB, OLED_RES_Pin|OLED_DC_Pin, GPIO_PIN_RESET);

  /*Configure GPIO pin : BLE_STATUS_Pin */
  GPIO_InitStruct.Pin = BLE_STATUS_Pin;
  GPIO_InitStruct.Mode = GPIO_MODE_INPUT;
  GPIO_InitStruct.Pull = GPIO_NOPULL;
  HAL_GPIO_Init(BLE_STATUS_GPIO_Port, &GPIO_InitStruct);

  /*Configure GPIO pins : BLE_RES_Pin COND_IN_Pin OLED_CS_Pin */
  GPIO_InitStruct.Pin = BLE_RES_Pin|COND_IN_Pin|OLED_CS_Pin;
  GPIO_InitStruct.Mode = GPIO_MODE_OUTPUT_PP;
  GPIO_InitStruct.Pull = GPIO_NOPULL;
  GPIO_InitStruct.Speed = GPIO_SPEED_FREQ_LOW;
  HAL_GPIO_Init(GPIOA, &GPIO_InitStruct);

  /*Configure GPIO pin : TEMP_Pin */
  GPIO_InitStruct.Pin = TEMP_Pin;
  GPIO_InitStruct.Mode = GPIO_MODE_OUTPUT_OD;
  GPIO_InitStruct.Pull = GPIO_NOPULL;
  GPIO_InitStruct.Speed = GPIO_SPEED_FREQ_LOW;
  HAL_GPIO_Init(TEMP_GPIO_Port, &GPIO_InitStruct);

  /*Configure GPIO pins : OLED_RES_Pin OLED_DC_Pin */
  GPIO_InitStruct.Pin = OLED_RES_Pin|OLED_DC_Pin;
  GPIO_InitStruct.Mode = GPIO_MODE_OUTPUT_PP;
  GPIO_InitStruct.Pull = GPIO_NOPULL;
  GPIO_InitStruct.Speed = GPIO_SPEED_FREQ_LOW;
  HAL_GPIO_Init(GPIOB, &GPIO_InitStruct);

  /* USER CODE BEGIN MX_GPIO_Init_2 */

  /* USER CODE END MX_GPIO_Init_2 */
}

/* USER CODE BEGIN 4 */

/* USER CODE END 4 */

/**
  * @brief  This function is executed in case of error occurrence.
  * @retval None
  */
void Error_Handler(void)
{
  /* USER CODE BEGIN Error_Handler_Debug */
  /* User can add his own implementation to report the HAL error return state */
  __disable_irq();
  while (1)
  {
  }
  /* USER CODE END Error_Handler_Debug */
}
#ifdef USE_FULL_ASSERT
/**
  * @brief  Reports the name of the source file and the source line number
  *         where the assert_param error has occurred.
  * @param  file: pointer to the source file name
  * @param  line: assert_param error line source number
  * @retval None
  */
void assert_failed(uint8_t *file, uint32_t line)
{
  /* USER CODE BEGIN 6 */
  /* User can add his own implementation to report the file name and line number,
     ex: printf("Wrong parameters value: file %s on line %d\r\n", file, line) */
  /* USER CODE END 6 */
}
#endif /* USE_FULL_ASSERT */
